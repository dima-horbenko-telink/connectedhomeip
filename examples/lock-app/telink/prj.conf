## prj.conf
```kconfig
#
#    Copyright (c) 2023 Project CHIP Authors
#
#    Licensed under the Apache License, Version 2.0 (the "License");
#    you may not use this file except in compliance with the License.
#    You may obtain a copy of the License at
#
#        http://www.apache.org/licenses/LICENSE-2.0
#
#    Unless required by applicable law or agreed to in writing, software
#    distributed under the License is distributed on an "AS IS" BASIS,
#    WITHOUT WARRANTIES OR CONDITIONS OF ANY KIND, either express or implied.
#    See the License for the specific language governing permissions and
#    limitations under the License.
#

# This sample uses sample-defaults.conf to set options common for all
# samples. This file should contain only options specific for this sample
# or overrides of default values.

# Enable CHIP
CONFIG_CHIP=y
CONFIG_STD_CPP17=y

# enable GPIO
CONFIG_GPIO=y

# enable PWM
CONFIG_PWM=y

# CHIP configuration
CONFIG_CHIP_PROJECT_CONFIG="include/CHIPProjectConfig.h"
CONFIG_CHIP_OPENTHREAD_CONFIG="../../platform/telink/project_include/OpenThreadConfig.h"

# 32774 == 0x8006 (example lock-app)
CONFIG_CHIP_DEVICE_PRODUCT_ID=32774

# Bluetooth Low Energy configuration
CONFIG_BT_DEVICE_NAME="TelinkLock"

# Disable Matter OTA DFU
CONFIG_CHIP_OTA_REQUESTOR=n
CONFIG_CHIP_DEVICE_SOFTWARE_VERSION=1

# Enable CHIP pairing automatically on application start.
CONFIG_CHIP_ENABLE_PAIRING_AUTOSTART=y

# Disable CHIP shell support
CONFIG_CHIP_LIB_SHELL=y

# Disable factory data support
CONFIG_CHIP_FACTORY_DATA=y
CONFIG_CHIP_FACTORY_DATA_BUILD=n
CONFIG_CHIP_FACTORY_DATA_MERGE_WITH_FIRMWARE=n
CONFIG_CHIP_CERTIFICATION_DECLARATION_STORAGE=y

# Enable Power Management
CONFIG_PM=n
```

## include/AppTask.h
```c
/*
 *
 *    Copyright (c) 2023 Project CHIP Authors
 *    All rights reserved.
 *
 *    Licensed under the Apache License, Version 2.0 (the "License");
 *    you may not use this file except in compliance with the License.
 *    You may obtain a copy of the License at
 *
 *        http://www.apache.org/licenses/LICENSE-2.0
 *
 *    Unless required by applicable law or agreed to in writing, software
 *    distributed under the License is distributed on an "AS IS" BASIS,
 *    WITHOUT WARRANTIES OR CONDITIONS OF ANY KIND, either express or implied.
 *    See the License for the specific language governing permissions and
 *    limitations under the License.
 */

#pragma once

#include "AppTaskCommon.h"
#include "BoltLockManager.h"

class AppTask : public AppTaskCommon
{
public:
    void UpdateClusterState(BoltLockManager::State state, BoltLockManager::OperationSource source);

private:
    friend AppTask & GetAppTask(void);
    friend class AppTaskCommon;

    CHIP_ERROR Init(void);

    static void LockActionEventHandler(AppEvent * event);
    static void LockStateChanged(BoltLockManager::State state, BoltLockManager::OperationSource source);

    static AppTask sAppTask;
};

inline AppTask & GetAppTask(void)
{
    return AppTask::sAppTask;
}

CHIP_ERROR InitDoorLockHandler();
```

## include/BoltLockManager.h
```c
/*
 *
 *    Copyright (c) 2023 Project CHIP Authors
 *    All rights reserved.
 *
 *    Licensed under the Apache License, Version 2.0 (the "License");
 *    you may not use this file except in compliance with the License.
 *    You may obtain a copy of the License at
 *
 *        http://www.apache.org/licenses/LICENSE-2.0
 *
 *    Unless required by applicable law or agreed to in writing, software
 *    distributed under the License is distributed on an "AS IS" BASIS,
 *    WITHOUT WARRANTIES OR CONDITIONS OF ANY KIND, either express or implied.
 *    See the License for the specific language governing permissions and
 *    limitations under the License.
 */

// #pragma once

// #include <app/clusters/door-lock-server/door-lock-server.h>
// #include <lib/core/ClusterEnums.h>
// #include <lib/support/ScopedBuffer.h>

// #include <zephyr/kernel.h>

// #include <cstdint>
// #include <vector>

// // Maximum number of credentials per user supported by lock
// #define CONFIG_LOCK_NUM_CREDENTIALS_PER_USER (2)
// // Maximum number of users supported by lock
// #define CONFIG_LOCK_NUM_USERS (5)
// // Maximum number of credentials supported by lock
// #define CONFIG_LOCK_NUM_CREDENTIALS (10)

// struct LockCredentialInfo;

// #define CONFIG_LOCK_CREDENTIAL_INFO_MAX_DATA_SIZE (20)
// #define CONFIG_LOCK_CREDENTIAL_INFO_MAX_TYPES (6)

// class AppEvent;

// class BoltLockManager
// {
// public:
//     BoltLockManager() :
//         mCredentials(CONFIG_LOCK_CREDENTIAL_INFO_MAX_TYPES, std::vector<LockCredentialInfo>(CONFIG_LOCK_NUM_CREDENTIALS + 1))
//     {}
//     static constexpr size_t kMaxCredentialLength = 128;

//     enum class State : uint8_t
//     {
//         kLockingInitiated = 0,
//         kLockingCompleted,
//         kUnlockingInitiated,
//         kUnlockingCompleted,
//     };

//     struct UserData
//     {
//         char mName[DOOR_LOCK_USER_NAME_BUFFER_SIZE];
//         CredentialStruct mCredentials[CONFIG_LOCK_NUM_CREDENTIALS_PER_USER];
//     };

//     struct CredentialData
//     {
//         chip::Platform::ScopedMemoryBuffer<uint8_t> mSecret;
//     };

//     using OperationSource     = chip::app::Clusters::DoorLock::OperationSourceEnum;
//     using StateChangeCallback = void (*)(State, OperationSource);

//     static constexpr uint32_t kActuatorMovementTimeMs = 2000;

//     void Init(StateChangeCallback callback);

//     State GetState() const { return mState; }
//     bool IsLocked() const { return mState == State::kLockingCompleted; }

//     bool GetUser(uint16_t userIndex, EmberAfPluginDoorLockUserInfo & user) const;
//     bool SetUser(uint16_t userIndex, chip::FabricIndex creator, chip::FabricIndex modifier, const chip::CharSpan & userName,
//                  uint32_t uniqueId, UserStatusEnum userStatus, UserTypeEnum userType, CredentialRuleEnum credentialRule,
//                  const CredentialStruct * credentials, size_t totalCredentials);

//     bool GetCredential(uint16_t credentialIndex, CredentialTypeEnum credentialType,
//                        EmberAfPluginDoorLockCredentialInfo & credential) const;
//     bool SetCredential(uint16_t credentialIndex, chip::FabricIndex creator, chip::FabricIndex modifier,
//                        DlCredentialStatus credentialStatus, CredentialTypeEnum credentialType,
//                        const chip::ByteSpan & credentialData);

//     bool ValidatePIN(const Optional<chip::ByteSpan> & pinCode, OperationErrorEnum & err) const;

//     void Lock(OperationSource source);
//     void Unlock(OperationSource source);

// private:
//     void SetState(State state, OperationSource source);

//     static void ActuatorTimerEventHandler(k_timer * timer);
//     static void ActuatorAppEventHandler(const AppEvent & aEvent);
//     friend BoltLockManager & BoltLockMgr();

//     State mState                             = State::kLockingCompleted;
//     StateChangeCallback mStateChangeCallback = nullptr;
//     OperationSource mActuatorOperationSource = OperationSource::kButton;
//     k_timer mActuatorTimer                   = {};

//     UserData mUserData[CONFIG_LOCK_NUM_USERS];
//     EmberAfPluginDoorLockUserInfo mUsers[CONFIG_LOCK_NUM_USERS] = {};

//     struct LockCredentialInfo
//     {
//         DlCredentialStatus status;
//         CredentialTypeEnum credentialType;
//         chip::FabricIndex createdBy;
//         chip::FabricIndex modifiedBy;
//         uint8_t credentialData[CONFIG_LOCK_CREDENTIAL_INFO_MAX_TYPES];
//         size_t credentialDataSize;
//     };
//     std::vector<std::vector<LockCredentialInfo>> mCredentials;

//     static BoltLockManager sLock;
// };

// inline BoltLockManager & BoltLockMgr()
// {
//     return BoltLockManager::sLock;
// }
#pragma once

#include <app/clusters/door-lock-server/door-lock-server.h>
#include <lib/core/ClusterEnums.h>
#include <lib/support/ScopedBuffer.h>

#include <zephyr/kernel.h>

#include <cstdint>

#define CONFIG_LOCK_NUM_CREDENTIALS_PER_USER (2)
// Maximum number of users supported by lock
#define CONFIG_LOCK_NUM_USERS (5)
// Maximum number of credentials supported by lock
#define CONFIG_LOCK_NUM_CREDENTIALS (10)

class AppEvent;

class BoltLockManager
{
public:
    static constexpr size_t kMaxCredentialLength = 128;

    enum class State : uint8_t
    {
        kLockingInitiated = 0,
        kLockingCompleted,
        kUnlockingInitiated,
        kUnlockingCompleted,
    };

    struct UserData
    {
        char mName[DOOR_LOCK_USER_NAME_BUFFER_SIZE];
        CredentialStruct mCredentials[CONFIG_LOCK_NUM_CREDENTIALS_PER_USER];
    };

    struct CredentialData
    {
        chip::Platform::ScopedMemoryBuffer<uint8_t> mSecret;
    };

    using OperationSource     = chip::app::Clusters::DoorLock::OperationSourceEnum;
    using StateChangeCallback = void (*)(State, OperationSource);

    static constexpr uint32_t kActuatorMovementTimeMs = 2000;

    void Init(StateChangeCallback callback);

    State GetState() const { return mState; }
    bool IsLocked() const { return mState == State::kLockingCompleted; }

    bool GetUser(uint16_t userIndex, EmberAfPluginDoorLockUserInfo & user) const;
    bool SetUser(uint16_t userIndex, chip::FabricIndex creator, chip::FabricIndex modifier, const chip::CharSpan & userName,
                 uint32_t uniqueId, UserStatusEnum userStatus, UserTypeEnum userType, CredentialRuleEnum credentialRule,
                 const CredentialStruct * credentials, size_t totalCredentials);

    bool GetCredential(uint16_t credentialIndex, CredentialTypeEnum credentialType,
                       EmberAfPluginDoorLockCredentialInfo & credential) const;
    bool SetCredential(uint16_t credentialIndex, chip::FabricIndex creator, chip::FabricIndex modifier,
                       DlCredentialStatus credentialStatus, CredentialTypeEnum credentialType, const chip::ByteSpan & secret);

    bool ValidatePIN(const Optional<chip::ByteSpan> & pinCode, OperationErrorEnum & err) const;

    void Lock(OperationSource source);
    void Unlock(OperationSource source);

private:
    void SetState(State state, OperationSource source);

    static void ActuatorTimerEventHandler(k_timer * timer);
    static void ActuatorAppEventHandler(const AppEvent & aEvent);
    friend BoltLockManager & BoltLockMgr();

    State mState                             = State::kLockingCompleted;
    StateChangeCallback mStateChangeCallback = nullptr;
    OperationSource mActuatorOperationSource = OperationSource::kButton;
    k_timer mActuatorTimer                   = {};

    UserData mUserData[CONFIG_LOCK_NUM_USERS];
    EmberAfPluginDoorLockUserInfo mUsers[CONFIG_LOCK_NUM_USERS] = {};

    CredentialData mCredentialData[CONFIG_LOCK_NUM_CREDENTIALS];
    EmberAfPluginDoorLockCredentialInfo mCredentials[CONFIG_LOCK_NUM_CREDENTIALS] = {};

    static BoltLockManager sLock;
};

inline BoltLockManager & BoltLockMgr()
{
    return BoltLockManager::sLock;
}
```

## src/AppTask.cpp
```c
/*
 *
 *    Copyright (c) 2023 Project CHIP Authors
 *    All rights reserved.
 *
 *    Licensed under the Apache License, Version 2.0 (the "License");
 *    you may not use this file except in compliance with the License.
 *    You may obtain a copy of the License at
 *
 *        http://www.apache.org/licenses/LICENSE-2.0
 *
 *    Unless required by applicable law or agreed to in writing, software
 *    distributed under the License is distributed on an "AS IS" BASIS,
 *    WITHOUT WARRANTIES OR CONDITIONS OF ANY KIND, either express or implied.
 *    See the License for the specific language governing permissions and
 *    limitations under the License.
 */

#include "AppTask.h"
#include "BoltLockManager.h"
#include <app/server/Server.h>
#include <credentials/FabricTable.h>
#include <app-common/zap-generated/attributes/Accessors.h>
#include <app/data-model/Nullable.h>
LOG_MODULE_DECLARE(app, CONFIG_CHIP_APP_LOG_LEVEL);

using namespace ::chip::app::Clusters::DoorLock;

namespace {
#if CONFIG_CHIP_ENABLE_APPLICATION_STATUS_LED
LEDWidget sLockLED;
#endif
} // namespace

#if defined(CONFIG_CHIP_LIB_SHELL)
#include "lib/shell/Engine.h"
#include "lib/shell/commands/Help.h"
#endif // CONFIG_CHIP_LIB_SHELL


#if defined(CONFIG_CHIP_LIB_SHELL)
using Shell::Engine;
using Shell::shell_command_t;
using Shell::streamer_get;
using Shell::streamer_printf;
using chip::app::DataModel::MakeNullable;
using ::chip::app::DataModel::Nullable;
using chip::app::DataModel::NullNullable;
Engine sShellDoorLockEvents;
Engine sShellDoorLockSubEvents;
#endif // defined(CONFIG_CHIP_LIB_SHELL)


AppTask AppTask::sAppTask;

CHIP_ERROR AppTask::Init(void)
{
#if APP_USE_EXAMPLE_START_BUTTON
    SetExampleButtonCallbacks(LockActionEventHandler);
#endif
    InitCommonParts();

#if CONFIG_CHIP_ENABLE_APPLICATION_STATUS_LED
    sLockLED.Init(GPIO_DT_SPEC_GET(DT_ALIAS(led2), gpios));
    sLockLED.Set(BoltLockMgr().IsLocked());
#endif

    BoltLockMgr().Init(LockStateChanged);

    // Disable auto-relock time feature.
    DoorLockServer::Instance().SetAutoRelockTime(kExampleEndpointId, 0);

    CHIP_ERROR err = ConnectivityMgr().SetBLEDeviceName("Telink Lock");
    if (err != CHIP_NO_ERROR)
    {
        LOG_ERR("SetBLEDeviceName fail");
        return err;
    }

    InitDoorLockHandler();

    return CHIP_NO_ERROR;
}

void AppTask::LockActionEventHandler(AppEvent * aEvent)
{
    if (BoltLockMgr().IsLocked())
    {
        BoltLockMgr().Unlock(BoltLockManager::OperationSource::kButton);
    }
    else
    {
        BoltLockMgr().Lock(BoltLockManager::OperationSource::kButton);
    }
}

void AppTask::LockStateChanged(BoltLockManager::State state, BoltLockManager::OperationSource source)
{
    switch (state)
    {
    case BoltLockManager::State::kLockingInitiated:
        LOG_INF("Lock action initiated");
#if CONFIG_CHIP_ENABLE_APPLICATION_STATUS_LED
        sLockLED.Blink(50, 50);
#endif
        break;
    case BoltLockManager::State::kLockingCompleted:
        LOG_INF("Lock action completed");
#if CONFIG_CHIP_ENABLE_APPLICATION_STATUS_LED
        sLockLED.Set(true);
#endif
        break;
    case BoltLockManager::State::kUnlockingInitiated:
        LOG_INF("Unlock action initiated");
#if CONFIG_CHIP_ENABLE_APPLICATION_STATUS_LED
        sLockLED.Blink(50, 50);
#endif
        break;
    case BoltLockManager::State::kUnlockingCompleted:
        LOG_INF("Unlock action completed");
#if CONFIG_CHIP_ENABLE_APPLICATION_STATUS_LED
        sLockLED.Set(false);
#endif
        break;
    }

    // Handle changing attribute state in the application
    sAppTask.UpdateClusterState(state, source);
}

void AppTask::UpdateClusterState(BoltLockManager::State state, BoltLockManager::OperationSource source)
{
    DlLockState newLockState;

    switch (state)
    {
    case BoltLockManager::State::kLockingCompleted:
        newLockState = DlLockState::kLocked;
        break;
    case BoltLockManager::State::kUnlockingCompleted:
        newLockState = DlLockState::kUnlocked;
        break;
    default:
        newLockState = DlLockState::kNotFullyLocked;
        break;
    }

    SystemLayer().ScheduleLambda([newLockState, source] {
        chip::app::DataModel::Nullable<chip::app::Clusters::DoorLock::DlLockState> currentLockState;
        chip::app::Clusters::DoorLock::Attributes::LockState::Get(kExampleEndpointId, currentLockState);

        if (currentLockState.IsNull())
        {
            // Initialize lock state with start value, but not invoke lock/unlock.
            chip::app::Clusters::DoorLock::Attributes::LockState::Set(kExampleEndpointId, newLockState);
        }
        else
        {
            LOG_INF("Updating LockState attribute");

            if (!DoorLockServer::Instance().SetLockState(kExampleEndpointId, newLockState, source))
            {
                LOG_ERR("Failed to update LockState attribute");
            }
        }
    });
}



#ifdef CONFIG_CHIP_LIB_SHELL

/********************************************************
 * Switch shell functions
 *********************************************************/

CHIP_ERROR LockHelpHandler(int argc, char ** argv)
{
    sShellDoorLockEvents.ForEachCommand(Shell::PrintCommandHelp, nullptr);
    return CHIP_NO_ERROR;
}

CHIP_ERROR DoorLockEventsHandler(int argc, char ** argv)
{
    if (argc == 0)
    {
        return LockHelpHandler(argc, argv);
    }

    return sShellDoorLockEvents.ExecCommand(argc, argv);
}

/********************************************************
 * OnOff switch shell functions
 *********************************************************/

CHIP_ERROR DoorLockHelpHandler(int argc, char ** argv)
{
    sShellDoorLockSubEvents.ForEachCommand(Shell::PrintCommandHelp, nullptr);
    return CHIP_NO_ERROR;
}


CHIP_ERROR DoorLockLockCommandHandler(int argc, char ** argv)
{
    if (argc == 0)
    {
        return DoorLockHelpHandler(argc, argv);
    }

    return sShellDoorLockSubEvents.ExecCommand(argc, argv);
}


CHIP_ERROR AlarmReadEventHandler(int argc, char ** argv)
{
     DoorLockServer::Instance().SendLockAlarmEvent(1, AlarmCodeEnum::kLockJammed);
    return CHIP_NO_ERROR;
}

CHIP_ERROR StateChangeReadEventHandler(int argc, char ** argv)
{
     DoorLockServer::Instance().SetDoorState(1, DoorStateEnum::kDoorClosed);
    return CHIP_NO_ERROR;
}


/**
    //  * @brief Send LockOperation event if opSuccess is true, otherwise send LockOperationError with given opErr code
    //  *
    //  * @param endpointId    endpoint where DoorLockServer is running
    //  * @param opType        lock operation type (lock, unlock, etc)
    //  * @param opSource      operation source (remote, keypad, auto, etc)
    //  * @param opErr         operation error code (if opSuccess == false)
    //  * @param userId        user id
    //  * @param fabricIdx     fabric index responsible for operating the lock
    //  * @param nodeId        node id responsible for operating the lock
    //  * @param credList      list of credentials used in lock operation (can be NULL if no credentials were used)
    //  * @param credListSize  size of credentials list (if 0, then no credentials were used)
    //  * @param opSuccess     flags if operation was successful or not
    //  */
    // void SendLockOperationEvent(chip::EndpointId endpointId, LockOperationTypeEnum opType, OperationSourceEnum opSource,
    //                             OperationErrorEnum opErr, const Nullable<uint16_t> & userId,
    //                             const Nullable<chip::FabricIndex> & fabricIdx, const Nullable<chip::NodeId> & nodeId,
    //                             const Nullable<List<const LockOpCredentials>> & credentials = NullNullable, bool opSuccess = true);


CHIP_ERROR OperationReadEventHandler(int argc, char ** argv)
{
    // ChipLogError(Zcl, "$$$$$$$$$$OperationReadEventHandler");
    // LockOpCredentials currentCredential;
    // if (emberAfPluginDoorLockGetCredential(1, 2, CredentialTypeEnum::kRfid, currentCredential))
    // {
    //     ChipLogError(Zcl, "$$$$$$$$$$OperationReadEventHandler OK");
    // }

    // NodeId nodeid= 1;


    // for (const auto & fabricInfo : : chip::Server::GetInstance().GetFabricTable())
    // {
    //     FabricIndex fabricIndex =  MakeNullable(fabricInfo.GetFabricIndex());

    // DoorLockServer::Instance().SendLockOperationEvent(1, LockOperationTypeEnum::kLock, OperationSourceEnum::kRemote, OperationErrorEnum::kUnspecified, chip::app::DataModel::MakeNullable(static_cast<uint16_t>(1)), lift, lift1,
    //                        currentCredential, true);
    // }

    // for (const auto & fb : chip::Server::GetInstance().GetFabricTable())
    // {
    //     FabricIndex fabricIndex = fb.GetFabricIndex();
    //     NodeId myNodeId = fb.GetNodeId();
        // ChipLogProgress(NotSpecified,
        //                 "---- Current Fabric nodeId=0x" ChipLogFormatX64 " fabricId=0x" ChipLogFormatX64 " fabricIndex=%d",
        //                 ChipLogValueX64(myNodeId), ChipLogValueX64(fb.GetFabricId()), fabricIndex);
        // DoorLockServer::Instance().SendLockOperationEvent(1, LockOperationTypeEnum::kLock, OperationSourceEnum::kRemote, OperationErrorEnum::kUnspecified, NullNullable, NullNullable, NullNullable,
        //                    NullNullable);
        DoorLockServer::Instance().SetLockState(1, DlLockState::kLocked);
    // }

    return CHIP_NO_ERROR;
}


// CHIP_ERROR OnOffSwitchCommandHandler(int argc, char ** argv)
// {
//     if (argc == 0)
//     {
//         return OnOffHelpHandler(argc, argv);
//     }

//     return sShellSwitchOnOffSubCommands.ExecCommand(argc, argv);
// }

// CHIP_ERROR OnSwitchCommandHandler(int argc, char ** argv)
// {
//     BindingCommandData * data = Platform::New<BindingCommandData>();
//     data->commandId           = Clusters::OnOff::Commands::On::Id;
//     data->clusterId           = Clusters::OnOff::Id;

//     DeviceLayer::PlatformMgr().ScheduleWork(SwitchWorkerFunction, reinterpret_cast<intptr_t>(data));
//     return CHIP_NO_ERROR;
// }

// CHIP_ERROR OffSwitchCommandHandler(int argc, char ** argv)
// {
//     BindingCommandData * data = Platform::New<BindingCommandData>();
//     data->commandId           = Clusters::OnOff::Commands::Off::Id;
//     data->clusterId           = Clusters::OnOff::Id;

//     DeviceLayer::PlatformMgr().ScheduleWork(SwitchWorkerFunction, reinterpret_cast<intptr_t>(data));
//     return CHIP_NO_ERROR;
// }

// CHIP_ERROR ToggleSwitchCommandHandler(int argc, char ** argv)
// {
//     BindingCommandData * data = Platform::New<BindingCommandData>();
//     data->commandId           = Clusters::OnOff::Commands::Toggle::Id;
//     data->clusterId           = Clusters::OnOff::Id;

//     DeviceLayer::PlatformMgr().ScheduleWork(SwitchWorkerFunction, reinterpret_cast<intptr_t>(data));
//     return CHIP_NO_ERROR;
// }

// /********************************************************
//  * bind switch shell functions
//  *********************************************************/

// CHIP_ERROR BindingHelpHandler(int argc, char ** argv)
// {
//     sShellSwitchBindingSubCommands.ForEachCommand(Shell::PrintCommandHelp, nullptr);
//     return CHIP_NO_ERROR;
// }

// CHIP_ERROR BindingSwitchCommandHandler(int argc, char ** argv)
// {
//     if (argc == 0)
//     {
//         return BindingHelpHandler(argc, argv);
//     }

//     return sShellSwitchBindingSubCommands.ExecCommand(argc, argv);
// }

// CHIP_ERROR BindingGroupBindCommandHandler(int argc, char ** argv)
// {
//     VerifyOrReturnError(argc == 2, CHIP_ERROR_INVALID_ARGUMENT);

//     EmberBindingTableEntry * entry = Platform::New<EmberBindingTableEntry>();
//     entry->type                    = EMBER_MULTICAST_BINDING;
//     entry->fabricIndex             = atoi(argv[0]);
//     entry->groupId                 = atoi(argv[1]);
//     entry->local                   = 1; // Hardcoded to endpoint 1 for now
//     entry->clusterId.SetValue(6);       // Hardcoded to OnOff cluster for now

//     DeviceLayer::PlatformMgr().ScheduleWork(BindingWorkerFunction, reinterpret_cast<intptr_t>(entry));
//     return CHIP_NO_ERROR;
// }

// CHIP_ERROR BindingUnicastBindCommandHandler(int argc, char ** argv)
// {
//     VerifyOrReturnError(argc == 3, CHIP_ERROR_INVALID_ARGUMENT);

//     EmberBindingTableEntry * entry = Platform::New<EmberBindingTableEntry>();
//     entry->type                    = EMBER_UNICAST_BINDING;
//     entry->fabricIndex             = atoi(argv[0]);
//     entry->nodeId                  = atoi(argv[1]);
//     entry->local                   = 1; // Hardcoded to endpoint 1 for now
//     entry->remote                  = atoi(argv[2]);
//     entry->clusterId.SetValue(6); // Hardcode to OnOff cluster for now

//     DeviceLayer::PlatformMgr().ScheduleWork(BindingWorkerFunction, reinterpret_cast<intptr_t>(entry));
//     return CHIP_NO_ERROR;
// }

// /********************************************************
//  * Groups switch shell functions
//  *********************************************************/

// CHIP_ERROR GroupsHelpHandler(int argc, char ** argv)
// {
//     sShellSwitchGroupsSubCommands.ForEachCommand(Shell::PrintCommandHelp, nullptr);
//     return CHIP_NO_ERROR;
// }

// CHIP_ERROR GroupsSwitchCommandHandler(int argc, char ** argv)
// {
//     if (argc == 0)
//     {
//         return GroupsHelpHandler(argc, argv);
//     }

//     return sShellSwitchGroupsSubCommands.ExecCommand(argc, argv);
// }

// /********************************************************
//  * Groups OnOff switch shell functions
//  *********************************************************/

// CHIP_ERROR GroupsOnOffHelpHandler(int argc, char ** argv)
// {
//     sShellSwitchGroupsOnOffSubCommands.ForEachCommand(Shell::PrintCommandHelp, nullptr);
//     return CHIP_NO_ERROR;
// }

// CHIP_ERROR GroupsOnOffSwitchCommandHandler(int argc, char ** argv)
// {
//     if (argc == 0)
//     {
//         return GroupsOnOffHelpHandler(argc, argv);
//     }

//     return sShellSwitchGroupsOnOffSubCommands.ExecCommand(argc, argv);
// }

// CHIP_ERROR GroupOnSwitchCommandHandler(int argc, char ** argv)
// {
//     BindingCommandData * data = Platform::New<BindingCommandData>();
//     data->commandId           = Clusters::OnOff::Commands::On::Id;
//     data->clusterId           = Clusters::OnOff::Id;
//     data->isGroup             = true;

//     DeviceLayer::PlatformMgr().ScheduleWork(SwitchWorkerFunction, reinterpret_cast<intptr_t>(data));
//     return CHIP_NO_ERROR;
// }

// CHIP_ERROR GroupOffSwitchCommandHandler(int argc, char ** argv)
// {
//     BindingCommandData * data = Platform::New<BindingCommandData>();
//     data->commandId           = Clusters::OnOff::Commands::Off::Id;
//     data->clusterId           = Clusters::OnOff::Id;
//     data->isGroup             = true;

//     DeviceLayer::PlatformMgr().ScheduleWork(SwitchWorkerFunction, reinterpret_cast<intptr_t>(data));
//     return CHIP_NO_ERROR;
// }

// CHIP_ERROR GroupToggleSwitchCommandHandler(int argc, char ** argv)
// {
//     BindingCommandData * data = Platform::New<BindingCommandData>();
//     data->commandId           = Clusters::OnOff::Commands::Toggle::Id;
//     data->clusterId           = Clusters::OnOff::Id;
//     data->isGroup             = true;

//     DeviceLayer::PlatformMgr().ScheduleWork(SwitchWorkerFunction, reinterpret_cast<intptr_t>(data));
//     return CHIP_NO_ERROR;
// }

/**
 * @brief configures switch matter shell
 *
 */
static void RegisterDoorLockCommands()
{
    static const shell_command_t sDoorLockSubCommands[] = {
        { &LockHelpHandler, "help", "Usage: lock <subcommand>" },
        { &DoorLockLockCommandHandler, "doorlock", " Usage: lock doorlock <subcommand>" },
    };

    static const shell_command_t sLockDoorLockSubCommands[] = {
        { &DoorLockHelpHandler,"help", "Usage : lock doorlock <subcommand>" },
        { &AlarmReadEventHandler,"DoorLockAlarm", " lock doorlock DoorLockAlarm"},
        { &StateChangeReadEventHandler,"DoorStateChange", "lock doorlock DoorStateChange"},
        { &OperationReadEventHandler,"LockOperation", "lock doorlock LockOperation" }
        // { &OperationErrorReadEventHandler, "LockOperationError", "lock doorlock LockOperationError" },
        // { &UserChangeReadEventHandler,"LockUserChange", "lock doorlock LockUserChange" }
    };

    // static const shell_command_t sSwitchGroupsSubCommands[] = { { &GroupsHelpHandler, "help", "Usage: switch groups <subcommand>" },
    //                                                             { &GroupsOnOffSwitchCommandHandler, "onoff",
    //                                                               "Usage: switch groups onoff <subcommand>" } };

    // static const shell_command_t sSwitchGroupsOnOffSubCommands[] = {
    //     { &GroupsOnOffHelpHandler, "help", "Usage: switch groups onoff <subcommand>" },
    //     { &GroupOnSwitchCommandHandler, "on", "Sends on command to bound group" },
    //     { &GroupOffSwitchCommandHandler, "off", "Sends off command to bound group" },
    //     { &GroupToggleSwitchCommandHandler, "toggle", "Sends toggle command to group" }
    // };

    // static const shell_command_t sSwitchBindingSubCommands[] = {
    //     { &BindingHelpHandler, "help", "Usage: switch binding <subcommand>" },
    //     { &BindingGroupBindCommandHandler, "group", "Usage: switch binding group <fabric index> <group id>" },
    //     { &BindingUnicastBindCommandHandler, "unicast", "Usage: switch binding group <fabric index> <node id> <endpoint>" }
    // };

    static const shell_command_t sLockCommand = { &DoorLockEventsHandler, "lock",
                                                    "Door-Lock commands. Usage: lock <subcommand>" };

    // sShellSwitchGroupsOnOffSubCommands.RegisterCommands(sSwitchGroupsOnOffSubCommands, ArraySize(sSwitchGroupsOnOffSubCommands));
    // sShellSwitchOnOffSubCommands.RegisterCommands(sSwitchOnOffSubCommands, ArraySize(sSwitchOnOffSubCommands));
    // sShellSwitchGroupsSubCommands.RegisterCommands(sSwitchGroupsSubCommands, ArraySize(sSwitchGroupsSubCommands));
    sShellDoorLockSubEvents.RegisterCommands(sLockDoorLockSubCommands, ArraySize(sLockDoorLockSubCommands));
    sShellDoorLockEvents.RegisterCommands(sDoorLockSubCommands, ArraySize(sDoorLockSubCommands));

    Engine::Root().RegisterCommands(&sLockCommand, 1);
}
#endif // CONFIG_CHIP_LIB_SHELL








CHIP_ERROR InitDoorLockHandler()
{
    // The initialization of binding manager will try establishing connection with unicast peers
    // so it requires the Server instance to be correctly initialized. Post the init function to
    // the event queue so that everything is ready when initialization is conducted.
#if defined(CONFIG_CHIP_LIB_SHELL)
    RegisterDoorLockCommands();
#endif
    return CHIP_NO_ERROR;
}
```

## src/BoltLockManager.cpp
```c
/*
 *
 *    Copyright (c) 2020 Project CHIP Authors
 *    Copyright (c) 2019 Google LLC.
 *    All rights reserved.
 *
 *    Licensed under the Apache License, Version 2.0 (the "License");
 *    you may not use this file except in compliance with the License.
 *    You may obtain a copy of the License at
 *
 *        http://www.apache.org/licenses/LICENSE-2.0
 *
 *    Unless required by applicable law or agreed to in writing, software
 *    distributed under the License is distributed on an "AS IS" BASIS,
 *    WITHOUT WARRANTIES OR CONDITIONS OF ANY KIND, either express or implied.
 *    See the License for the specific language governing permissions and
 *    limitations under the License.
 */

#include "BoltLockManager.h"

#include "AppConfig.h"
// #include "AppEvent.h"
#include "AppTask.h"

using namespace chip;

BoltLockManager BoltLockManager::sLock;

void BoltLockManager::Init(StateChangeCallback callback)
{
    mStateChangeCallback = callback;

    k_timer_init(&mActuatorTimer, &BoltLockManager::ActuatorTimerEventHandler, nullptr);
    k_timer_user_data_set(&mActuatorTimer, this);
}

bool BoltLockManager::GetUser(uint16_t userIndex, EmberAfPluginDoorLockUserInfo & user) const
{
    // userIndex is guaranteed by the caller to be between 1 and CONFIG_LOCK_NUM_USERS
    user = mUsers[userIndex - 1];

    ChipLogProgress(Zcl, "Getting lock user %u: %s", static_cast<unsigned>(userIndex),
                    user.userStatus == UserStatusEnum::kAvailable ? "available" : "occupied");

    return true;
}

bool BoltLockManager::SetUser(uint16_t userIndex, FabricIndex creator, FabricIndex modifier, const CharSpan & userName,
                              uint32_t uniqueId, UserStatusEnum userStatus, UserTypeEnum userType,
                              CredentialRuleEnum credentialRule, const CredentialStruct * credentials, size_t totalCredentials)
{
    // userIndex is guaranteed by the caller to be between 1 and CONFIG_LOCK_NUM_USERS
    UserData & userData = mUserData[userIndex - 1];
    auto & user         = mUsers[userIndex - 1];

    VerifyOrReturnError(userName.size() <= DOOR_LOCK_MAX_USER_NAME_SIZE, false);
    VerifyOrReturnError(totalCredentials <= CONFIG_LOCK_NUM_CREDENTIALS_PER_USER, false);

    Platform::CopyString(userData.mName, userName);
    memcpy(userData.mCredentials, credentials, totalCredentials * sizeof(CredentialStruct));

    user.userName           = CharSpan(userData.mName, userName.size());
    user.credentials        = Span<const CredentialStruct>(userData.mCredentials, totalCredentials);
    user.userUniqueId       = uniqueId;
    user.userStatus         = userStatus;
    user.userType           = userType;
    user.credentialRule     = credentialRule;
    user.creationSource     = DlAssetSource::kMatterIM;
    user.createdBy          = creator;
    user.modificationSource = DlAssetSource::kMatterIM;
    user.lastModifiedBy     = modifier;

    ChipLogProgress(Zcl, "Setting lock user %u: %s", static_cast<unsigned>(userIndex),
                    userStatus == UserStatusEnum::kAvailable ? "available" : "occupied");

    return true;
}

bool BoltLockManager::GetCredential(uint16_t credentialIndex, CredentialTypeEnum credentialType,
                                    EmberAfPluginDoorLockCredentialInfo & credential) const
{
    VerifyOrReturnError(credentialIndex > 0 && credentialIndex <= CONFIG_LOCK_NUM_CREDENTIALS, false);

    credential = mCredentials[credentialIndex - 1];

    ChipLogProgress(Zcl, "Getting lock credential %u: %s", static_cast<unsigned>(credentialIndex),
                    credential.status == DlCredentialStatus::kAvailable ? "available" : "occupied");

    return true;
}

bool BoltLockManager::SetCredential(uint16_t credentialIndex, FabricIndex creator, FabricIndex modifier,
                                    DlCredentialStatus credentialStatus, CredentialTypeEnum credentialType, const ByteSpan & secret)
{
    VerifyOrReturnError(credentialIndex > 0 && credentialIndex <= CONFIG_LOCK_NUM_CREDENTIALS, false);
    VerifyOrReturnError(secret.size() <= kMaxCredentialLength, false);

    CredentialData & credentialData = mCredentialData[credentialIndex - 1];
    auto & credential               = mCredentials[credentialIndex - 1];

    if (!secret.empty())
    {
        memcpy(credentialData.mSecret.Alloc(secret.size()).Get(), secret.data(), secret.size());
    }

    credential.status             = credentialStatus;
    credential.credentialType     = credentialType;
    credential.credentialData     = ByteSpan(credentialData.mSecret.Get(), secret.size());
    credential.creationSource     = DlAssetSource::kMatterIM;
    credential.createdBy          = creator;
    credential.modificationSource = DlAssetSource::kMatterIM;
    credential.lastModifiedBy     = modifier;

    ChipLogProgress(Zcl, "Setting lock credential %u: %s", static_cast<unsigned>(credentialIndex),
                    credential.status == DlCredentialStatus::kAvailable ? "available" : "occupied");

    return true;
}

bool BoltLockManager::ValidatePIN(const Optional<ByteSpan> & pinCode, OperationErrorEnum & err) const
{
    // Optionality of the PIN code is validated by the caller, so assume it is OK not to provide the PIN code.
    if (!pinCode.HasValue())
    {
        return true;
    }

    // Check the PIN code
    for (const auto & credential : mCredentials)
    {
        if (credential.status == DlCredentialStatus::kAvailable || credential.credentialType != CredentialTypeEnum::kPin)
        {
            continue;
        }

        if (credential.credentialData.data_equal(pinCode.Value()))
        {
            ChipLogDetail(Zcl, "Valid lock PIN code provided");
            return true;
        }
    }

    ChipLogDetail(Zcl, "Invalid lock PIN code provided");
    err = OperationErrorEnum::kInvalidCredential;

    return false;
}

void BoltLockManager::Lock(OperationSource source)
{
    VerifyOrReturn(mState != State::kLockingCompleted);
    SetState(State::kLockingInitiated, source);

    mActuatorOperationSource = source;
    k_timer_start(&mActuatorTimer, K_MSEC(kActuatorMovementTimeMs), K_NO_WAIT);
}

void BoltLockManager::Unlock(OperationSource source)
{
    VerifyOrReturn(mState != State::kUnlockingCompleted);
    SetState(State::kUnlockingInitiated, source);

    mActuatorOperationSource = source;
    k_timer_start(&mActuatorTimer, K_MSEC(kActuatorMovementTimeMs), K_NO_WAIT);
}

void BoltLockManager::ActuatorTimerEventHandler(k_timer * timer)
{
    // The timer event handler is called in the context of the system clock ISR.
    // Post an event to the application task queue to process the event in the
    // context of the application thread.

    AppEvent event;
    event.Type               = AppEvent::kEventType_Timer;
    event.TimerEvent.Context = static_cast<BoltLockManager *>(k_timer_user_data_get(timer));
    event.Handler            = (EventHandler)BoltLockManager::ActuatorAppEventHandler;
    GetAppTask().PostEvent(&event);
}

void BoltLockManager::ActuatorAppEventHandler(const AppEvent & event)
{
    BoltLockManager * lock = static_cast<BoltLockManager *>(event.TimerEvent.Context);

    if (!lock)
    {
        return;
    }

    switch (lock->mState)
    {
    case State::kLockingInitiated:
        lock->SetState(State::kLockingCompleted, lock->mActuatorOperationSource);
        break;
    case State::kUnlockingInitiated:
        lock->SetState(State::kUnlockingCompleted, lock->mActuatorOperationSource);
        break;
    default:
        break;
    }
}

void BoltLockManager::SetState(State state, OperationSource source)
{
    mState = state;

    if (mStateChangeCallback != nullptr)
    {
        mStateChangeCallback(state, source);
    }
}
```

## src/ZclCallbacks.cpp
```c
/*
 *
 *    Copyright (c) 2023 Project CHIP Authors
 *    All rights reserved.
 *
 *    Licensed under the Apache License, Version 2.0 (the "License");
 *    you may not use this file except in compliance with the License.
 *    You may obtain a copy of the License at
 *
 *        http://www.apache.org/licenses/LICENSE-2.0
 *
 *    Unless required by applicable law or agreed to in writing, software
 *    distributed under the License is distributed on an "AS IS" BASIS,
 *    WITHOUT WARRANTIES OR CONDITIONS OF ANY KIND, either express or implied.
 *    See the License for the specific language governing permissions and
 *    limitations under the License.
 */

#include "AppTask.h"
#include "BoltLockManager.h"

#include <app-common/zap-generated/attributes/Accessors.h>
#include <app-common/zap-generated/ids/Clusters.h>
#include <app/ConcreteAttributePath.h>
#include <app/clusters/door-lock-server/door-lock-server.h>
#include <app/data-model/Nullable.h>
#include <lib/core/DataModelTypes.h>
#include <lib/support/CodeUtils.h>




using namespace ::chip;
using namespace ::chip::app::Clusters;
using namespace ::chip::app::Clusters::DoorLock;
using ::chip::app::DataModel::Nullable;

LOG_MODULE_DECLARE(app, CONFIG_CHIP_APP_LOG_LEVEL);

void MatterPostAttributeChangeCallback(const chip::app::ConcreteAttributePath & attributePath, uint8_t type, uint16_t size,
                                       uint8_t * value)
{
    VerifyOrReturn(attributePath.mClusterId == DoorLock::Id && attributePath.mAttributeId == DoorLock::Attributes::LockState::Id);

    switch (*value)
    {
    case to_underlying(DlLockState::kLocked):
        BoltLockMgr().Lock(BoltLockManager::OperationSource::kRemote);
        break;
    case to_underlying(DlLockState::kUnlocked):
        BoltLockMgr().Unlock(BoltLockManager::OperationSource::kRemote);
        break;
    default:
        break;
    }
}

bool emberAfPluginDoorLockGetUser(EndpointId endpointId, uint16_t userIndex, EmberAfPluginDoorLockUserInfo & user)
{
    return BoltLockMgr().GetUser(userIndex, user);
}

bool emberAfPluginDoorLockSetUser(EndpointId endpointId, uint16_t userIndex, FabricIndex creator, FabricIndex modifier,
                                  const CharSpan & userName, uint32_t uniqueId, UserStatusEnum userStatus, UserTypeEnum userType,
                                  CredentialRuleEnum credentialRule, const CredentialStruct * credentials, size_t totalCredentials)
{
    return BoltLockMgr().SetUser(userIndex, creator, modifier, userName, uniqueId, userStatus, userType, credentialRule,
                                 credentials, totalCredentials);
}

bool emberAfPluginDoorLockGetCredential(EndpointId endpointId, uint16_t credentialIndex, CredentialTypeEnum credentialType,
                                        EmberAfPluginDoorLockCredentialInfo & credential)
{
    return BoltLockMgr().GetCredential(credentialIndex, credentialType, credential);
}

bool emberAfPluginDoorLockSetCredential(EndpointId endpointId, uint16_t credentialIndex, FabricIndex creator, FabricIndex modifier,
                                        DlCredentialStatus credentialStatus, CredentialTypeEnum credentialType,
                                        const ByteSpan & secret)
{
    return BoltLockMgr().SetCredential(credentialIndex, creator, modifier, credentialStatus, credentialType, secret);
}

bool emberAfPluginDoorLockOnDoorLockCommand(EndpointId endpointId, const Nullable<chip::FabricIndex> & fabricIdx,
                                            const Nullable<chip::NodeId> & nodeId, const Optional<ByteSpan> & pinCode,
                                            OperationErrorEnum & err)
{
    ChipLogError(Zcl, "$$$$$BoltLockManager::ValidatePIN(10)");
    bool result = BoltLockMgr().ValidatePIN(pinCode, err);
ChipLogError(Zcl, "$$$$$$emberAfPluginDoorLockOnDoorLockCommand %x, %x", result,true);
    /* Handle changing attribute state on command reception */
    if (true==result)
    {
        BoltLockMgr().Lock(BoltLockManager::OperationSource::kRemote);
    }

    return result;
}

bool emberAfPluginDoorLockOnDoorUnlockCommand(EndpointId endpointId, const Nullable<chip::FabricIndex> & fabricIdx,
                                              const Nullable<chip::NodeId> & nodeId, const Optional<ByteSpan> & pinCode,
                                              OperationErrorEnum & err)
{
    bool result = BoltLockMgr().ValidatePIN(pinCode, err);

    ChipLogError(Zcl, "$$$$$$$$$$emberAfPluginDoorLockOnDoorUnlockCommand %x,%x", result,true);
    /* Handle changing attribute state on command reception */
    if (true==result)
    {
        BoltLockMgr().Unlock(BoltLockManager::OperationSource::kRemote);
    }

    // ChipLogProgress(Zcl, "Device App::DoorLock::emberAfPluginDoorLockOnDoorLockCommand");
    // return DoorLockServer::Instance().SetLockState(endpointId, DlLockState::kLocked);


    return result;
}


bool emberAfPluginDoorLockOnDoorUnboltCommand(chip::EndpointId endpointId, const Nullable<chip::FabricIndex> & fabricIdx,
                                              const Nullable<chip::NodeId> & nodeId, const Optional<ByteSpan> & pinCode,
                                              OperationErrorEnum & err)
{
    bool result = BoltLockMgr().ValidatePIN(pinCode, err);

    ChipLogError(Zcl, "$$$$$$$$$$emberAfPluginDoorLockOnDoorUnlockCommand %x,%x", result,true);
    /* Handle changing attribute state on command reception */
    if (true==result)
    {
        BoltLockMgr().Unlock(BoltLockManager::OperationSource::kRemote);
    }

    return result;
}

void emberAfDoorLockClusterInitCallback(EndpointId endpoint)
{
    ChipLogError(Zcl, "$$$$$$$$$$emberAfDoorLockClusterInitCallback %x", endpoint);
    DoorLockServer::Instance().InitServer(endpoint);

    const auto logOnFailure = [](EmberAfStatus status, const char * attributeName) {
        if (status != EMBER_ZCL_STATUS_SUCCESS)
        {
            ChipLogError(Zcl, "Failed to set DoorLock %s: %x", attributeName, status);
        }
    };

    logOnFailure(DoorLock::Attributes::LockType::Set(endpoint, DlLockType::kDeadBolt), "type");
    logOnFailure(DoorLock::Attributes::NumberOfTotalUsersSupported::Set(endpoint, CONFIG_LOCK_NUM_USERS), "number of users");
    logOnFailure(DoorLock::Attributes::NumberOfPINUsersSupported::Set(endpoint, CONFIG_LOCK_NUM_USERS), "number of PIN users");
    logOnFailure(DoorLock::Attributes::NumberOfRFIDUsersSupported::Set(endpoint, 0), "number of RFID users");
    logOnFailure(DoorLock::Attributes::NumberOfCredentialsSupportedPerUser::Set(endpoint, CONFIG_LOCK_NUM_CREDENTIALS_PER_USER),
                 "number of credentials per user");

    // Set FeatureMap to (kUser|kPinCredential), default is:
    // (kUser|kAccessSchedules|kRfidCredential|kPinCredential) 0x113
    // logOnFailure(DoorLock::Attributes::FeatureMap::Set(endpoint, 0x101), "feature map");

    GetAppTask().UpdateClusterState(BoltLockMgr().GetState(), BoltLockManager::OperationSource::kUnspecified);
}


DlStatus emberAfPluginDoorLockSetSchedule(chip::EndpointId endpointId, uint8_t weekdayIndex, uint16_t userIndex,
                                          DlScheduleStatus status, DaysMaskMap daysMask, uint8_t startHour, uint8_t startMinute,
                                          uint8_t endHour, uint8_t endMinute)
{
    return DlStatus::kSuccess;
}
```
